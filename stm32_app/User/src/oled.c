#include "delay.h"
#include "oled.h"
#include "debug_usart.h"
#include "myiic.h"
#include <string.h>

#define OLED_ADDR_W				0x78	// oled i2c slave addr	write
#define OLED_ADDR_R				0x79	// oled i2c slave addr	read
#define CMD_CTL_BYTE			0x00	// command control byte
#define DATA_CTL_BYTE			0x40	// data control byte

#define SET_CMD_CTL				0xFD	// set command
#define UNLOCK_CTL				0x12	// Unlock OLED driver IC MCU interface from entering command (RESET)
#define LOCK_CTL				0x16	// Lock OLED driver IC MCU interface from entering command
#define DISPLAY_OFF				0xAE	// 0xAE => Display Off
#define DISPLAY_ON				0xAF	// 0xAF => Display On
#define CLOCK_OSC_CMD			0xD5	// Set Display Clock Divide Ratio / Oscillator cmd
#define CLOCK_OSC				0xA1	// Set Clock as 110 Frames/Sec	default: 0x70
#define MULTI_RATIO_CMD			0xA8	// Set Multiplex Ratio cmd
#define MULTI_RATIO				0x1F	// 1/32 Duty (0x0F~0x3F) Multiplex Ratio
#define DISPLAY_OFFSET_CMD		0xD3	// Set Display Offset cmd
#define DISPLAY_OFFSET			0x00	// Shift Mapping RAM Counter (0x00~0x3F)
#define START_LINE_DEFAULT		0x40	// Set Display Start Line, and Default => 0x40 (0x00)
#define START_LINE				0x00	// start line
#define LOW_POWER_CMD			0xD8	// Set Low Power Display Mode
#define LOW_POWER				0x05	// Set Low Power Display Mode (0x04/0x05)
#define MEMORY_ADDR_MODE_CMD	0x20	// Set Memory Addressing Mode cmd
#define MEMORY_ADDR_MODE		0x02	// Set Page Addressing Mode (0x00/0x01/0x02)
#define SEGMENT_REMAP			0xA1	// Set SEG/Column Mapping (0xA0/0xA1)
#define COMMON_REMAP			0xC8	// Scan from COM63 to 0--Set COM/Row Scan Direction (0xC0/0xC8)
#define COM_PINS_HARDWARE_CMD	0xDA	// Set COM Pins Hardware Configuration 
#define COM_PINS_HARDWARE		0x12 	// Set Alternative Configuration (0x02/0x12)
#define CONTRAST_CTL_CMD		0x81	// Set Contrast Control for Bank 0	
#define BRIGHTNESS				0xEF	// brightness
#define PRECHAGE_PERIOD_CMD		0xD9	// Set Pre-Charge Period
#define PRECHAGE_PERIOD			0x15	// Set Pre-Charge as 1 Clock & Discharge as 5 Clocks
#define SET_VCOMH_CMD			0xDB	// Set VCOMH Deselect Level cmd
#define SET_VCOMH				0x08	// Set VCOMH Deselect Level	
#define ENTIRE_DISPLAY			0xA4	// Disable Entire Display On
#define INVERSE_DISPLAY			0xA6	// Disable Inverse Display On (0xA6/0xA7)
#define PAGE_ADDR				0xB0	// Set Page Start Address for Page Addressing Mode
#define LOW_COLUMN_START_ADDR	0x00	// Set Lower Column Start Address for Page Addressing Mode
#define HIGH_COLUMN_START_ADDR 	0x10	// Set Higher Column Start Address for Page Addressing Mode  
#define CLEAR_START_LINE		0x40	// Start line for fill RAM
#define COLUMN_TOTAL			128		// Total column 128
#define PAGE_TOTAL				8		// Total page
#define CLEAR_SCREEN			0x00	// Clear screen

#define XLEVEL_L				0x00
#define XLEVEL_H				0x10
#define XLEVEL					((XLEVEL_H & 0x0F) * 16 + XLEVEL_L)
#define MAX_COLUMN				128
#define MAX_ROW					32

#define START_PAGE_IP			0x03
#define START_COLUMN_IP			0x13

extern unsigned char reg_val[I2C_REG_NUM];

// 8*16
u8 ascii_3[][16] = {
	// 8 * 16
{0x00,0x00,0x07,0xF0,0x0F,0xF0,0x18,0x80,0x18,0x80,0x0F,0xF0,0x07,0xF0,0x00,0x00},		/*(1) A*/		
{0x00,0x00,0x1F,0xF0,0x1F,0xF0,0x11,0x10,0x11,0x10,0x1F,0xF0,0x0E,0xE0,0x00,0x00},		/*(2) B*/
{0x00,0x00,0x0F,0xE0,0x1F,0xF0,0x10,0x10,0x10,0x10,0x1C,0x70,0x0C,0x60,0x00,0x00},		/*(3) C*/
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{0x00,0x00,0x04,0x30,0x04,0x70,0x04,0xD0,0x05,0x90,0x07,0x10,0x06,0x10,0x00,0x00},		/* (52)z */
	
};
u8 ascii_2[][32] = {
	//picture 8*16
	{0x00,0x00,0x00,0x00,0xFF,0xC0,0x80,0x40,0x84,0x40,0x84,0x50,0x84,0x50,0x84,0x70,0x84,0x50,0x84,0x50,0x84,0x40,0x95,0x40,0x8E,0x40,0xC4,0xC0,0x00,0x00,0x00,0x00},		/*	(1)send */		
	{0x00,0x00,0x00,0x00,0x1F,0x80,0x1F,0x80,0x1F,0x80,0x3F,0xC0,0x7F,0xE0,0xFF,0xF0,0x00,0x00,0x09,0x00,0x46,0x20,0x40,0x20,0x30,0xC0,0x0F,0x00,0x00,0x00,0x00,0x00},		/*	(2)mute */
	{0x00,0x00,0x00,0x00,0x00,0x00,0x00,0x00,0x1F,0x00,0x00,0x80,0x7E,0x50,0xFF,0x50,0xFF,0x70,0xFF,0x50,0x7E,0x50,0x00,0x80,0x1F,0x00,0x00,0x00,0x00,0x00,0x00,0x00},		/*	(3)biyin */
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	{0x00,0x00,0x00,0x00,0xFF,0xC0,0x80,0x40,0x80,0x40,0x80,0x50,0x80,0x50,0x80,0x70,0x80,0x50,0x80,0x50,0x80,0x40,0x80,0x40,0x80,0x40,0xFF,0xC0,0x00,0x00,0x00,0x00},		/*	(13)show */	
};


u8 ascii_1[][5]={	
	//5 * 8
	{0x00,0x60,0x60,0x00,0x00},		//   ( 1)  . - 0x002E Full Stop
	{0x3E,0x51,0x49,0x45,0x3E},		//   ( 2)  0 - 0x0030 Digit Zero
	{0x00,0x42,0x7F,0x40,0x00},		//   ( 3)  1 - 0x0031 Digit One
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	{0x06,0x49,0x49,0x29,0x1E},		//   ( 11)  9 - 0x0039 Dight Nine
//	{0x00,0x36,0x36,0x00,0x00},		//   ( 12)  : - 0x003A Colon
//	{0x00,0x41,0x7F,0x41,0x00},		//   ( 13)  I - 0x0049 Latin Capital Letter I
//	{0x7F,0x09,0x09,0x09,0x06},		//   ( 14)  P - 0x0050 Latin Capital Letter P
};


//=-=-=-=-=-=-=-=-=-=-=-=-=-=-=-=-=-=-=-=-=-=-=-=-=-=-=-=-=-=-=-=-=-=-=-=-=-=-=-=
//  Patterns
//=-=-=-=-=-=-=-=-=-=-=-=-=-=-=-=-=-=-=-=-=-=-=-=-=-=-=-=-=-=-=-=-=-=-=-=-=-=-=-=
u8 uniV[][48]={			// UniV OLED
	0x00,0x00,0xFC,0xFC,0xFC,0xFC,0x00,0x00,0x00,0xFC,0xFC,0xFC,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0x00,
	0x00,0x00,0x07,0x0F,0x1F,0x1F,0x1C,0x18,0x1C,0x1F,0x1F,0x0F,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0x00,
	0x00,0x80,0xE0,0xE0,0xF0,0x70,0x30,0x70,0xF0,0xE0,0xE0,0x80,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0x80,
	0x00,0x0F,0x3F,0x3F,0x7F,0x70,0x60,0x70,0x7F,0x3F,0x3F,0x0F,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0x0F,
};

/* 5*8 */
u8 ascii_57_1[240][5]={		// Refer to "Times New Roman" Font Database...
						//   Basic Characters
	{0x00,0x00,0x4F,0x00,0x00},		//   (  1)  ! - 0x0021 Exclamation Mark
	{0x00,0x07,0x00,0x07,0x00},		//   (  2)  " - 0x0022 Quotation Mark
	{0x14,0x7F,0x14,0x7F,0x14},		//   (  3)  # - 0x0023 Number Sign
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	{0x74,0x42,0x41,0x42,0x74},		//   (240)    - 0x2302 House
};

unsigned char ascii_57_2[107][5]={		// Refer to "Times New Roman" Font Database... 5 * 8
						//   Greek & Japanese Letters
	{0x7E,0x11,0x11,0x11,0x7E},		//   (  1)  A - 0x0391 Greek Capital Letter Alpha
	{0x7F,0x49,0x49,0x49,0x36},		//   (  2)  B - 0x0392 Greek Capital Letter Beta
	{0x7F,0x02,0x01,0x01,0x03},		//   (  3)    - 0x0393 Greek Capital Letter Gamma
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	{0x07,0x05,0x07,0x00,0x00},		//   (107)    - 0xFF9F Katakana Semi-Voiced Sound Mark
};

static void oled_gpio_configuration(void)
{
    GPIO_InitTypeDef GPIO_InitStructure;

    GPIO_InitStructure.GPIO_Pin = GPIO_Pin_1;	// 复位
    GPIO_InitStructure.GPIO_Speed = GPIO_Speed_50MHz;
    GPIO_InitStructure.GPIO_Mode = GPIO_Mode_Out_PP;
    GPIO_Init(GPIOC, &GPIO_InitStructure);

    GPIO_InitStructure.GPIO_Pin = GPIO_Pin_10;	// 使能
    GPIO_InitStructure.GPIO_Speed = GPIO_Speed_50MHz;
    GPIO_InitStructure.GPIO_Mode = GPIO_Mode_Out_PP;
    GPIO_Init(GPIOD, &GPIO_InitStructure);
	

}

/* RES# GPIO: Active Low */
static void oled_res_high(void)
{
	GPIO_SetBits(GPIOC, GPIO_Pin_1);
}

/* RES# GPIO: Active Low */
static void oled_res_low(void)
{
	GPIO_ResetBits(GPIOC, GPIO_Pin_1);
}

void oled_reset(void)
{
	oled_res_high();
	delay_us(10);
	oled_res_low();
}

void oled_powerOn(void)
{
	GPIO_SetBits(GPIOD, GPIO_Pin_10);  //Vdd
	oled_res_low();
	//delay_us(5);
	delay_ms(40);
	oled_res_high();
	delay_us(5);
}

void oled_powerOff(void)
{
	GPIO_ResetBits(GPIOD, GPIO_Pin_10);
}

/* D′êy?Y */
#if 0
static void oled_sendByte(u8 data)
{
	IIC_Start(IIC_E_BUS0);
	IIC_SendByte(IIC_E_BUS0, OLED_ADDR_W);
	IIC_WaitAck(IIC_E_BUS0);
	IIC_SendByte(IIC_E_BUS0, DATA_CTL_BYTE);
	IIC_WaitAck(IIC_E_BUS0);
	IIC_SendByte(IIC_E_BUS0, data);
	IIC_WaitAck(IIC_E_BUS0);
	IIC_Stop(IIC_E_BUS0);
}
#endif

/* D′?üá?*/
static void oled_sendCmd(u8 cmd)
{
	IIC_Start(IIC_E_BUS0);
	IIC_SendByte(IIC_E_BUS0, OLED_ADDR_W);
	IIC_WaitAck(IIC_E_BUS0);
	IIC_SendByte(IIC_E_BUS0, CMD_CTL_BYTE);//(0x00)
	IIC_WaitAck(IIC_E_BUS0);
	IIC_SendByte(IIC_E_BUS0, cmd);
	IIC_WaitAck(IIC_E_BUS0);
	IIC_Stop(IIC_E_BUS0);
}

/**
 * command_lock_ctl:
 * 		0x12 => Driver IC interface is unlocked from entering command.
 *		0x16 => All Commands are locked except 0xFD.
 */
static void set_command_lock(u8 command_lock_ctl)
{
	oled_sendCmd(SET_CMD_CTL);		// Set Command Lock
	oled_sendCmd(command_lock_ctl);	// Default => 0x12
}

/**
 * on_off:
 *		0xAE => Display Off
 *		0xAF => Display On
 */
//static void set_display_on_off(u8 on_off)
//{
//	oled_sendCmd(on_off);	// Default => 0xAE
//}
static void set_display_on_off(u8 cmd_value)
{
	oled_sendCmd(cmd_value);	// Default => 0xAE
}

/**
 * clock_oscillator:
 *		D[3:0] => Display Clock Divider
 *		D[7:4] => Oscillator Frequency
 */
static void set_display_clock(u8 clock_oscillator)
{
	oled_sendCmd(CLOCK_OSC_CMD);		// Set Display Clock Divide Ratio / Oscillator 
	oled_sendCmd(clock_oscillator);	// Default => 0x70
}

static void set_multiplex_ratio(u8 multi_radio)
{
	oled_sendCmd(MULTI_RATIO_CMD);	// Set Multiplex Ratio
	oled_sendCmd(multi_radio);		// Default => 0x3F (1/64 Duty)
}

static void set_display_offset(u8 display_offset)
{
	oled_sendCmd(DISPLAY_OFFSET_CMD);	// Set Display Offset
	oled_sendCmd(DISPLAY_OFFSET);		// Default => 0x00
}

/* Set Display Start Line, and Default => 0x40 (0x00)*/
static void set_start_line(u8 start_line)
{
	oled_sendCmd(START_LINE_DEFAULT | start_line);
}

static void set_low_power(u8 low_power)
{
	oled_sendCmd(LOW_POWER_CMD);	// Set Low Power Display Mode
	oled_sendCmd(low_power);		// Default => 0x04 (Normal Power Mode)
}

/**
 * page_addr_mode:
 *		0x00 => Horizontal Addressing Mode
 * 		0x01 => Vertical Addressing Mode
 *		0x02 => Page Addressing Mode
 */
static void set_addressing_mode(u8 page_addr_mode)
{
	oled_sendCmd(MEMORY_ADDR_MODE_CMD);	// Set Memory Addressing Mode
	oled_sendCmd(page_addr_mode);		// Default => 0x02
}

/**
 * segment_remap:
 *		Default => 0xA0
 *		0xA0 => Column Address 0 Mapped to SEG0
 *		0xA1 => Column Address 0 Mapped to SEG127
 */
static void set_segment_remap(u8 segment_remap)
{
	oled_sendCmd(segment_remap);	//  Set Segment Re-Map
}

/**
 * Set COM Output Scan Direction
 * common_remap:
 *		Default => 0xC0
 *		0xC0 => Scan from COM0 to 63
 *		0xC8 => Scan from COM63 to 0
 */
static void set_common_remap(u8 common_remap)
{
	oled_sendCmd(common_remap);
}

/**
 * Set COM Pins Hardware Configuration
 * com_pins_hardware:
 *		Default => 0x12
 *		Alternative COM Pin Configuration
 *		Disable COM Left/Right Re-Map
 */
static void set_common_config(u8 com_pins_hardware)
{
	oled_sendCmd(COM_PINS_HARDWARE_CMD);
	oled_sendCmd(com_pins_hardware);
}

static void set_contrast_control(u8 contrast_ctl)
{
	oled_sendCmd(CONTRAST_CTL_CMD);	// Set Contrast Control for Bank 0
	oled_sendCmd(contrast_ctl);		// Default => 0x7F
}

/**
 * Set Pre-Charge Period
 * precharge_period:
 *		Default => 0x22 (2 Display Clocks [Phase 2] / 2 Display Clocks [Phase 1])
 *		D[3:0] => Phase 1 Period in 1~15 Display Clocks
 *		D[7:4] => Phase 2 Period in 1~15 Display Clocks
 */
static void set_precharge_period(u8 precharge_period)
{
	oled_sendCmd(PRECHAGE_PERIOD_CMD);	// Set Pre-Charge Period
	oled_sendCmd(PRECHAGE_PERIOD);
}

static void set_VCOMH(u8 vcomh_value)
{
	oled_sendCmd(SET_VCOMH_CMD);	// Set VCOMH Deselect Level
	oled_sendCmd(SET_VCOMH);		//  Default => 0x34 (0.78*VCC)
}

/**
 * Set Entire Display On / Off
 * entire_display:
 *		Default => 0xA4
 *		0xA4 => Normal Display
 *		0xA5 => Entire Display On
 */
static void set_entire_display(u8 entire_display)
{
	oled_sendCmd(entire_display);
}

/**
 * Set Inverse Display On/Off
 * inverse_display:
 *		Default => 0xA6
 *		0xA6 => Normal Display
 *		0xA7 => Inverse Display On
 */
static void set_inverse_display(u8 inverse_display)
{
	oled_sendCmd(inverse_display);
}

/**
 * Set Page Start Address for Page Addressing Mode
 *  Default => 0xB0 (0x00)
 */
static void set_start_page(u8 page)
{
	oled_sendCmd(PAGE_ADDR | page);
}

static void set_start_column(u8 column)
{
	// Set Lower Column Start Address for Page Addressing Mode 
	// Default => 0x00 
	oled_sendCmd(LOW_COLUMN_START_ADDR + column % 16);
	
	// Set Higher Column Start Address for Page Addressing Mode
	// Default => 0x10
	oled_sendCmd(HIGH_COLUMN_START_ADDR + column / 16);
}

/* Show Regular Pattern (Full Screen) */
static void fill_RAM(u8 data)
{
	u8 i, j;

	for(i = 0; i < PAGE_TOTAL; i++)						// page total
	{
		set_start_page(i);
		set_start_column(0x00);
		
		IIC_Start(IIC_E_BUS0);
		IIC_SendByte(IIC_E_BUS0, OLED_ADDR_W);
		IIC_WaitAck(IIC_E_BUS0);
		IIC_SendByte(IIC_E_BUS0, CLEAR_START_LINE);		// Start line
		IIC_WaitAck(IIC_E_BUS0);

		for (j = 0; j < COLUMN_TOTAL; j++)
		{
			IIC_SendByte(IIC_E_BUS0, data);
			IIC_WaitAck(IIC_E_BUS0);
		}

		IIC_Stop(IIC_E_BUS0);
	}
}

void oled_clear_diplay(void)
{
    fill_RAM(CLEAR_SCREEN);					// Clear Screen
}

/* Show Regular Pattern (Partial or Full Screen) */
static void fill_block(u8 data, u8 start_page, u8 end_page, u8 start_column, u8 total_columns)
{
	u8 i, j;

	for (i = start_page; i < (end_page + 1); i++)
	{
		set_start_page(i);
		set_start_column(start_column);
		
		IIC_Start(IIC_E_BUS0);
		IIC_SendByte(IIC_E_BUS0, OLED_ADDR_W);
		IIC_WaitAck(IIC_E_BUS0);
		IIC_SendByte(IIC_E_BUS0, CLEAR_START_LINE);		// Start line
		IIC_WaitAck(IIC_E_BUS0);

		for (j = 0; j < total_columns; j++)
		{
			IIC_SendByte(IIC_E_BUS0, data);
			IIC_WaitAck(IIC_E_BUS0);
		}

		IIC_Stop(IIC_E_BUS0);
	}
}

void show_pattern(u8 *data_pointer, u8 start_page, u8 end_page, u8 start_column, u8 total_columns)
{
	u8 *src_pointer;
	u8 i, j;

	src_pointer = data_pointer;
	for (i = start_page; i < (end_page + 1); i++)
	{
		set_start_page(i);
		set_start_column(start_column);

		IIC_Start(IIC_E_BUS0);
		IIC_SendByte(IIC_E_BUS0, OLED_ADDR_W);
		IIC_WaitAck(IIC_E_BUS0);
		IIC_SendByte(IIC_E_BUS0, START_LINE_DEFAULT);	// start line
		IIC_WaitAck(IIC_E_BUS0);

		for (j = 0; j < total_columns; j++)
		{
			IIC_SendByte(IIC_E_BUS0, *src_pointer);
			IIC_WaitAck(IIC_E_BUS0);
			src_pointer++;
		}

		IIC_Stop(IIC_E_BUS0);
	}
}

void show_font57(u8 database, u8 data_ascii, u8 start_page, u8 start_column)
{
	u8 *src;
	u8 i;

	switch(database) 
	{
		case 1:
			src = &ascii_57_1[data_ascii - 1][0];//各种符号参数
			break;
		case 2:
			src = &ascii_57_2[data_ascii - 1][0];//日语和希腊字母
		  break;
		case 3:
			src = &ascii_1[data_ascii - 1][0];//全数字 为IP设计
			break;
		default:
			break;
	}

	set_start_page(start_page);
	set_start_column(start_column);

	IIC_Start(IIC_E_BUS0);
	IIC_SendByte(IIC_E_BUS0, OLED_ADDR_W);
	IIC_WaitAck(IIC_E_BUS0);
	IIC_SendByte(IIC_E_BUS0, START_LINE_DEFAULT);
	IIC_WaitAck(IIC_E_BUS0);

	for (i = 0; i < 5; i++)
	{
		IIC_SendByte(IIC_E_BUS0, *src);
		IIC_WaitAck(IIC_E_BUS0);
		src++;
	}
	IIC_SendByte(IIC_E_BUS0, 0x00);
	IIC_WaitAck(IIC_E_BUS0);
	IIC_Stop(IIC_E_BUS0);
}

void show_string(u8 database, u8 *data, u8 start_page, u8 start_column)
{
	u8 *src ;

	src = data;
	show_font57(1, 96, start_page, start_column);

	while(1)
	{
		show_font57(database, *src, start_page, start_column);
		src++;
		start_column += 6;
		if (0 == *src)
			break;
	}
}

/**
 * font57
 * start_page: 		0x07
 * start_column:	0x13
 */
static void oled_display_ip(u8 start_page, u8 start_column)
{
	u8 value = 0;
	u8 ip[17] = {0};
	u8 i;

	for (i = 0; i < 4; i++)
	{
		value = reg_val[OLED_IP + i+1];
		if (value >= 100)
		{
			ip[0 + (i * 4)] = (value / 100) + 2;
			value %= 100;
		}
		else
		{
			ip[0 + (i * 4)] = (value / 100) + 2;
		}
		
		if (value >= 10)
		{
			ip[1 + (i * 4)] = (value /10) + 2;
			value %= 10;
		}
		else
		{
			ip[1 + (i * 4)] = (value /10) + 2;
		}
		
		ip[2 + (i * 4)] = value + 2;
		ip[3 + (i * 4)] = 1;
		
		if (i == 3)
		{
			ip[3 + (i * 4)] = 0;
		}
	}	
	fill_block(0x00, start_page, start_page,0,128);
	show_string(3, ip, start_page, start_column);
}

static unsigned char oled_reversBit(unsigned char ucValue)
{
    static unsigned char sta[16] = {
        0x00,0x08,0x04,0x0C,0x02,0x0A,0x06,0x0E,0x01,0x09,0x05,0x0D,0x03,0x0B,0x07,0x0F
    };

    unsigned char ucResult = 0; //没有判断
    ucResult |= (sta[ucValue & 0xF]) << 4;
    ucResult |= sta[ucValue >> 4];
	
    return ucResult;
}

static void oled_print_font(u8 choice, u8 fontSel, 
						u8 disPos, u8 start_page, u8 start_column)
{
	u8 *src;
	u8 *tmp;
	u8 i;

	switch(choice)
	{
		case 1:
			break;
		case 2:
			src = (u8 *)&ascii_2[(fontSel-1)][0];
			break;
		case 3:
			src = (u8 *)&ascii_3[(fontSel-1)][0];
			break;
		default:
			break;
	}

	tmp = src;
	set_start_page(start_page);
	set_start_column(start_column);

	IIC_Start(IIC_E_BUS0);
	IIC_SendByte(IIC_E_BUS0, OLED_ADDR_W);
	IIC_WaitAck(IIC_E_BUS0);
	IIC_SendByte(IIC_E_BUS0, START_LINE_DEFAULT);
	IIC_WaitAck(IIC_E_BUS0);

	for(i = 0; i < disPos; i++)
	{
		IIC_SendByte(IIC_E_BUS0, oled_reversBit(*tmp));
		IIC_WaitAck(IIC_E_BUS0);
		tmp += 2;
	}

	IIC_SendByte(IIC_E_BUS0, 0x00);
	IIC_WaitAck(IIC_E_BUS0);	
	IIC_Stop(IIC_E_BUS0);
	set_start_page(start_page + 1);
	set_start_column(start_column);

	IIC_Start(IIC_E_BUS0);
	IIC_SendByte(IIC_E_BUS0, OLED_ADDR_W);
	IIC_WaitAck(IIC_E_BUS0);
	IIC_SendByte(IIC_E_BUS0, START_LINE_DEFAULT);
	IIC_WaitAck(IIC_E_BUS0);

	tmp = src + 1;
	for(i = 0; i < disPos; i++)
	{
		IIC_SendByte(IIC_E_BUS0, oled_reversBit(*tmp));
		IIC_WaitAck(IIC_E_BUS0);
		tmp += 2;

	}	

	IIC_SendByte(IIC_E_BUS0, 0x00);
	IIC_WaitAck(IIC_E_BUS0);	
	IIC_Stop(IIC_E_BUS0);
}

/**
 * 总共4页，column=32: 4*8
 * 128*32 
 */
static void oled_print_string(u8 *data, u8 start_page, u8 start_column, u8 len)  //输出大号的字母
{
	u8 *src;

	src = data;
	while(len--)
	{
/*		if (0x20 == *src)
		{
			start_page += 8;
			src++;
			continue;
		}*/

		oled_print_font(3, *src, 8, start_page, start_column);
		src++;
		start_column += 8;
//		if (0x30 == *src)
//		{
//			break;
//		}
	}
}

#if 0
static void oled_print_string_asc(void)
{
	u8 i = 0;
	u8 len = 0;
	u8 len_flag = 1;
	u8 asc[14] = {0};

	for (i = 0; i < 13; i++)
	{
		if ((reg_val[i + 18] >= 'A') && (reg_val[i + 18] <= 'Z'))
		{
			asc[i] = reg_val[i + 18] - 0x41 +  1; 
			if (len_flag == 1)
			{
				len++;
			}
		}
		else if ((reg_val[i + 18] >= 'a') && (reg_val[i + 18] <= 'z'))
		{
			asc[i] = reg_val[i + 18] - 0x61 +  0x1B; 
			if (len_flag == 1)
			{
				len++;
			}
		}
		else 
		{
			asc[i] = reg_val[i + 18];
			if (reg_val[i + 18] == 0x30)
			{
				len_flag = 0;
			}
			if (len_flag == 1)
			{
				len++;
			}
		}
	}	

	fill_block(0x00, 0x04, 0x5, 0xa, 118);
	oled_print_string(asc, 0x04, XLEVEL + 0xa + (13 - len) * 4, 14);
}
#endif

static void acs_to_logolib(u8 *data,u8 len)
{

	u8 i ;
	for(i = 0;i < len;i++)
	{
		if(*data >='A' && *data <='Z')
		{
			*data -= 64;
		}
		else if(*data >='a' && *data <='z')
		{
			*data -= 70;
		}
		data++;
	}

}

static void acs_to_fontlib(u8 *data,u8 len)
{
	u8 i ;
	for(i = 0;i < len;i++)
	{
		if(*data >='A' && *data <='z')
		{
			*data -=32;
		}
		else if(32 ==*data)
		{
			*data += 0x40;
		}
		data++;			
	}
}

static void oled_print_pics(u8 *data, u8 start_page, u8 start_column)
{
	u8 *src;
	src = data;

	if (0x35 == *src)
	{
		start_column += 24;
		src++;
		return;
	}

	oled_print_font(2, *src, 16, start_page, start_column);
	start_column += 24;
	if (0 == *src)
	{
		return;
	}
}

static void oled_display_pics(void)   //更新图标
{
	u8 value = 0;
	u8 pic[2] = {0};
	u8 i = 0;
	value = reg_val[OLED_PIC];
	
	for(i = 0; i < 6; i++)
	{
	
		if(value & (0x20 >> i))
		{
			pic[0] = i + 1;
			pic[1] = 0;
		}
		else
		{
			pic[0] = i + 7;
			pic[1] = 0;
		}
		if((0 == i) && 0 != (value & 0x40))
		{
			pic[0] = 13;
			pic[1] = 0; 			
	
		}	
		oled_print_pics(pic, 0, 13 + 17 * i);
	}

}

void oled_print_logo(void)
{
	//u8 Logo[] = {9,6,18,5,5,3,15,13,13,0};
    //u8 Logo[] = {19,20,1,18,20,9,14,7,0};//starting
    u8 Logo[] = {9, 6, 18, 5, 5, 3, 15, 13, 13, 0};
		oled_print_string(Logo, 0x01, 28, 9);

/*		u8 Logo[] = {9, 6, 18, 5, 5, 3, 15, 13, 13, 0};
		u8 Logo1[10],i;
		for(i = 0;i < 9;i++)
		{
			Logo1[i] = Logo[i] + 26;
		}
		
		oled_print_string(Logo, 0, 28, 9);
		oled_print_string(Logo1, 2, 28, 9);*/
	
/*		int i;
		u8 logo[] = {18,17,16};
		u8 logo1[] = {1,2,3,4,5,6,7,8};
		
		show_string(1, logo, 0, 0);		
		for(i = 0;i < 8;i++)
		{
			oled_print_font(2, logo1[i], 16, 2,i*16);
		}*/
}

static void oled_init(void)
{	
	/*
	oled_res_low();
	delay_us(100);		// ? TODO
	oled_res_high();
	*/

	set_command_lock(UNLOCK_CTL);			// Unlock Driver IC (0x12/0x16)
	set_display_on_off(DISPLAY_OFF);		// Display Off (0xAE/0xAF)	
	set_display_clock(CLOCK_OSC);			// Set Clock as 110 Frames/Sec
	set_multiplex_ratio(MULTI_RATIO);		// 1/32 Duty (0x0F~0x3F)
	set_display_offset(DISPLAY_OFFSET);		// Shift Mapping RAM Counter (0x00~0x3F)
	set_start_line(START_LINE);				// Set Mapping RAM Display Start Line (0x00~0x3F)
	set_low_power(LOW_POWER);				// Set Low Power Display Mode (0x04/0x05)
	set_addressing_mode(MEMORY_ADDR_MODE);	// Set Page Addressing Mode (0x00/0x01/0x02)
	set_segment_remap(SEGMENT_REMAP);		// Set SEG/Column Mapping (0xA0/0xA1)
	set_common_remap(COMMON_REMAP);			// Set COM/Row Scan Direction (0xC0/0xC8)
	set_common_config(COM_PINS_HARDWARE);	// Set Alternative Configuration (0x02/0x12)
	set_contrast_control(BRIGHTNESS);		// Set SEG Output Current
	set_precharge_period(PRECHAGE_PERIOD);	// Set Pre-Charge as 1 Clock & Discharge as 5 
	set_VCOMH(SET_VCOMH);					// Set VCOM Deselect Level
	set_entire_display(ENTIRE_DISPLAY);		// Disable Entire Display On (0xA4/0xA5)
	set_inverse_display(INVERSE_DISPLAY);	// Disable Inverse Display On (0xA6/0xA7)   
	fill_RAM(CLEAR_SCREEN);					// Clear Screen
	
	set_display_on_off(DISPLAY_ON);			// Display On (0xAE/0xAF)
	delay_ms(10);
}

void oled_initDev(void)
{							
	oled_gpio_configuration();
	oled_powerOn();
	oled_init();
	oled_print_logo();
}

void oled_deinitDev(void)
{
	set_display_on_off(DISPLAY_OFF);
	oled_powerOff();
}

void oled_update_display(void)
{	
	unsigned char asc[21] = {0};
	unsigned char len = 0;	
	char i = 0;
	
	if(0x80 == (reg_val[OLED_Logo] & 0x80))
	{
		len = (reg_val[OLED_Logo] & 0x7f); // 后7位，表示长度
		reg_val[OLED_Logo] = 0;
		for(i = 0; i < len ; i++)
		{
			asc[i] = reg_val[i + OLED_Logo_1];
		}
		acs_to_logolib(asc,len);      
		oled_print_string(asc, 0x01, (128 - 8 * len)/2, len);
	}
	
    if(0x1 == reg_val[SYS_INIT_COM])   /*?μí33?ê??ˉíê3éoóòa??DDò?′????á?ù??ê?*/
    {
    	reg_val[SYS_INIT_COM] = 0;
    	fill_RAM(CLEAR_SCREEN);
    }
    
	if(0x1 == reg_val[OLED_REQ_PIC])  	/*图案改变*/
	{
		reg_val[OLED_REQ_PIC] = 0x0;
		oled_display_pics();

	}
	
	if(0x1 == reg_val[OLED_IP])   /*ip显示*/
	{
		reg_val[OLED_IP] = 0x0;
		oled_display_ip(START_PAGE_IP, START_COLUMN_IP);
	}
	
	if(0x1 == (reg_val[OLED_DISPLAY_OFF] & 0x1))  //oled 开关
	{
		reg_val[OLED_DISPLAY_OFF] = 0x0;
		set_display_on_off(DISPLAY_ON);
	}
	
	if(0x2 == (reg_val[OLED_DISPLAY_OFF] & 0x2))
	{
		reg_val[OLED_DISPLAY_OFF] = 0x0;
		set_display_on_off(DISPLAY_OFF);
	}
	
    if(0x4 == (reg_val[OLED_DISPLAY_OFF] & 0x4))  //对比度设置
    {
    	reg_val[OLED_DISPLAY_OFF] = 0x0;
    	set_contrast_control(reg_val[OLED_CONTRAST]);	
    }
    
    if(0x80 == (reg_val[OLED_ASC] & 0x80))
    {
    	len = (reg_val[OLED_ASC] & 0x7f); //后七位为字符串长度
    	reg_val[OLED_ASC] = 0x0;
    	for(i = 0; i < len ; i++)
    	{
    		asc[i] = reg_val[i + OLED_1];
    	}
    	acs_to_fontlib(asc,len);      //ascii×a×??oμ?×??a
    	fill_block(0x00, 3, 3,0,128);
    	show_string(1, asc, 0x03, (128 - 6 * len)/2);
    }
}

